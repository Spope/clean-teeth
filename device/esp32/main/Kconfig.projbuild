## device/esp32/main/Kconfig.projbuild
```kconfig
menu "Brushy Buddy"
    config BRUSHY_THEME
        string "Theme"
        default "minecraft"
        help
            The id of the theme the device is built with, e.g. minecraft or dragon: one of
            assets/themes/<id>.json (exported from prototype/themes/<id>.js, see docs/themes.md).
            Only its artwork goes into the firmware. Each theme has an sdkconfig.<id> that sets it.

    config BRUSHY_BRIGHTNESS
        int "Screen brightness (%)"
        range 1 100
        default 80
        help
            Set once at startup. A build can override it, e.g. CONFIG_BRUSHY_BRIGHTNESS=60
            in sdkconfig.dragon.

    config BRUSHY_BENCH
        bool "Benchmark: play every scene and trick in turn, logging the frame rate"
        default n
        depends on LV_USE_PERF_MONITOR_LOG_MODE
        help
            Build with sdkconfig.bench (see the README) instead of turning this on by hand.
endmenu
```
